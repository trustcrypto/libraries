/*
 * File:    avrnacl_small/crypto_hashblocks/sha512.c
 * Author:  Michael Hutter, Peter Schwabe
 * Version: Wed Aug 6 13:39:23 2014 +0200
 * Public Domain
 */

#include <avr/pgmspace.h> 

#include "avrnacl.h"
#include "bigint.h"

#define myu64_convert_bigendian avrnacl_myu64_convert_bigendian
#define Ch avrnacl_Ch
#define Maj avrnacl_Maj
#define Sigma avrnacl_Sigma
#define sigma avrnacl_sigma
#define M avrnacl_M
#define expand avrnacl_expand

typedef struct{
  unsigned char v[8];
} myu64;

extern void myu64_convert_bigendian(unsigned char *r, const unsigned char *x, unsigned char length);
extern void Ch(myu64 *r, const myu64 *x, const myu64 *y, const myu64 *z);
extern void Maj(myu64 *r, const myu64 *x, const myu64 *y, const myu64 *z);
extern void Sigma(myu64 *r, const myu64 *x, unsigned char c1, unsigned char c2, unsigned char c3);
extern void sigma(myu64 *r, const myu64 *x, unsigned char c1, unsigned char c2, unsigned char c3);
extern void M(myu64 *w0, const myu64 *w14, const myu64 *w9, const myu64 *w1);
extern void expand(myu64 *w);

const myu64 roundconstants_pgm[80] PROGMEM = {
{{0x22, 0xae, 0x28, 0xd7, 0x98, 0x2f, 0x8a, 0x42}},
{{0xcd, 0x65, 0xef, 0x23, 0x91, 0x44, 0x37, 0x71}},
{{0x2f, 0x3b, 0x4d, 0xec, 0xcf, 0xfb, 0xc0, 0xb5}},
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{{0x17, 0x58, 0x47, 0x4a, 0x8c, 0x19, 0x44, 0x6c}}};


static void myF(myu64 *state, const myu64 *w, int k_index)
{
  myu64 t, t1, t2;
  unsigned char i;
  Ch(&t, state+4, state+5, state+6);
  Sigma(&t1, state+4, 14, 18, 23);
  bigint_add64(t1.v, t1.v, (state+7)->v);  
  bigint_add64(t1.v, t1.v, t.v);  
  for(i=0;i<8;i++)
    t.v[i] = pgm_read_byte((unsigned char *)roundconstants_pgm+k_index*8+i);
  bigint_add64(t1.v, t1.v, t.v);  
  bigint_add64(t1.v, t1.v, w->v);  
  Sigma(&t2, state+0, 28, 34, 5);
  Maj(&t,state+0,state+1,state+2);
  bigint_add64(t2.v, t2.v, t.v);    
  *(state+7) = *(state+6);
  *(state+6) = *(state+5);
  *(state+5) = *(state+4);
  bigint_add64((state+4)->v, (state+3)->v, t1.v);  
  *(state+3) = *(state+2);
  *(state+2) = *(state+1);
  *(state+1) = *(state+0);
  bigint_add64((state+0)->v, t1.v, t2.v);
}

int crypto_hashblocks_sha512(
    unsigned char *statebytes,
    const unsigned char *in,crypto_uint16 inlen
    )
{
  myu64 state[8];
  myu64 state_safe[8];  
  myu64 w[16];
  unsigned char i;

  myu64_convert_bigendian(state[0].v, statebytes + 0, 8);
  for (i=0;i<8;i++)
    state_safe[i] = state[i];
	
  while (inlen >= 128) 
  {
    for(i=0;i<16;i++)
      myu64_convert_bigendian(w[i].v, in + 8*i, 1);
	 
    for(i=0;i<16;i++)
      myF(state, w+i, i);

    expand(w);

    for(i=0;i<16;i++)
      myF(state, w+i, i+16);

    expand(w);

    for(i=0;i<16;i++)
      myF(state, w+i, i+32);

    expand(w);

    for(i=0;i<16;i++)
      myF(state, w+i, i+48);

    expand(w);

    for(i=0;i<16;i++)
      myF(state, w+i, i+64);
	
    for(i=0;i<8;i++)
      bigint_add64(state[i].v, state[i].v, state_safe[i].v);  

    for(i=0;i<8;i++)
      state_safe[i] = state[i];

    in += 128;
    inlen -= 128;
  }
 
  myu64_convert_bigendian(statebytes+0, state_safe[0].v, 8);

  return inlen;
}
